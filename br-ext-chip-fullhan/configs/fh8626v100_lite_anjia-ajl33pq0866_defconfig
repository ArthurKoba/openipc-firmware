## general/package/anjia-ajl33pq0866-board-support/Config.in
```kconfig
config BR2_PACKAGE_ANJIA_AJL33PQ0866_BOARD_SUPPORT
	bool "anjia-ajl33pq0866-board-support"
	depends on BR2_arm
	help
	  Board-specific PTZ support for the ANJIA AJL33PQ0866 camera with
	  Fullhan FH8626V100. Builds the source-based four-channel hardware-PWM
	  controller, startup position calibration, persistent coordinates, and
	  the OpenIPC gpio-motors compatibility command.

	  The PWM/GPIO map is specific to this retail camera and must not be
	  selected by generic FH8626V100 firmware targets.
```

## general/package/fullhan-media-fh8626v100/Config.in
```kconfig
config BR2_PACKAGE_FULLHAN_MEDIA_FH8626V100
	bool "FH8626V100 proprietary media kernel runtime"
	depends on BR2_arm
	help
	  Pinned proprietary FH8626V100 media kernel modules and ARC firmware.

	  Active OpenIPC source branches do not store these binary artifacts.
	  Buildroot downloads the hardware-proven payloads from an immutable
	  archive commit and verifies every file with SHA-256 before install.

	  This package provides only the still-unreplaced kernel/ARC runtime:
	  VMM, XBUS RPC, media_process, ISP, H.264 encoder, JPEG, BGM and
	  gpio_wave. Sensor/MIPI/userspace compatibility is owned separately.

	  https://github.com/ArthurKoba/openipc-firmware
```

## general/package/fullhan-osdrv-fh8626v100/Config.in
```kconfig
config BR2_PACKAGE_FULLHAN_OSDRV_FH8626V100
	bool "fullhan-osdrv-fh8626v100"
	depends on BR2_arm
	help
	  FH8626V100 media modules, ARC firmware, GC1054 sensor plug-in,
	  and the OpenIPC media-owner utility.

	  The kernel-facing loader is SoC-generic. Board-specific sensor
	  reset and power sequencing must be supplied by a device profile.
```

## general/package/majestic-fh8852v200-compat/Config.in
```kconfig
config BR2_PACKAGE_MAJESTIC_FH8852V200_COMPAT
	bool "FH8626V100 Majestic FH8852V200 compatibility runtime"
	depends on BR2_arm
	depends on BR2_TOOLCHAIN_USES_MUSL
	select BR2_PACKAGE_JSON_C
	select BR2_PACKAGE_LIBEVENT_OPENIPC
	select BR2_PACKAGE_LIBOGG_OPENIPC
	select BR2_PACKAGE_LIBYAML
	select BR2_PACKAGE_MBEDTLS_OPENIPC
	select BR2_PACKAGE_OPUS_OPENIPC
	select BR2_PACKAGE_OPUS_OPENIPC_FIXED_POINT
	select BR2_PACKAGE_MAJESTIC_WEBUI
	select BR2_PACKAGE_MAJESTIC_FONTS
	help
	  FH8626V100 compatibility runtime for the FH8852V200 Majestic binary.

	  Majestic HTTP/WebUI is untouched and owns its normal ports directly.
	  The package selects the stock WebUI and Majestic font asset needed by
	  the OSD feature profile.

	  Source compatibility covers the active Fullhan feature closure:
	  GC1054/MIPI, VMM, SYS/VPSS, multi-channel H.264 VENC/RC/stream,
	  JPEG/MJPEG, motion/YCmean, OSD GraphV2 and RTX audio/VQE.

	  Retained donor ISP/ispcore/advapi libraries remain isolated as one
	  coherent userspace ISP context. No FH8852 kernel modules, firmware,
	  load scripts or donor sensor plug-ins are installed.

	  HEVC/H.265 is explicitly unsupported by the stock FH8626 encoder stack;
	  unsupported SDK-only calls are errors, not fake-success stubs.

	  Default boot remains media-off. Manual strict/full-feature runners are
	  provided for target acceptance.
```
